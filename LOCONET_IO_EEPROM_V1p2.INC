

;***************************************************************************
;* LocoNet In/out module met PIC 18F4620 microcontroller                   *
;*                                                                         *
;* Geschreven door Geert Giebens voor PIC 18F4620 microcontroller          *
;*                                                                         *
;* Datum: 29 november 2018                      Versie LOCONET IO V1.2     *
;*                                                                         *
;* Filenaam: LOCONET_IO_EEPROM_V1p2.INC                                    *
;*                                                                         *
;***************************************************************************

;Initiatie EEPROM met Data voor eerste gebruik µC

;CODE FUNCTION:
;00000000  	0x00	NOP
;00000001	0x01	SWITCH
;00000011	0x03	BUTTON
;00000101	0x05	BUTTON1
;00000111	0x07	BUTTON2
;00100001	0x21	BUTTON ON/OFF
;00001000	0x08	DIGITAL OUT
;00010000	0x10	COIL1
;00010010	0x12	COIL2
;01000000	0x40	PWM/LED
;01000010	0x42	LED BLINKING
;10000000	0x80	SERVO

        #DEFINE EEPROM_ADR_LOW_FUNCTION     0x00
        #DEFINE EEPROM_ADR_LOW_CONST1       0x20
        #DEFINE EEPROM_ADR_LOW_CONST2       0x40
        #DEFINE EEPROM_ADR_LOW_CONST3       0x60
        #DEFINE EEPROM_ADR_LOW_BINAIR       0x80
        #DEFINE EEPROM_ADR_LOW_ADR1L        0xA0
        #DEFINE EEPROM_ADR_LOW_ADR1H        0xC0

        #DEFINE LF1ADR                      0xE0
        #DEFINE LF2ADR                      0xE8
        #DEFINE LF3ADR                      0xF0
        #DEFINE LF4ADR                      0xF8


	ORG	0xf00000

        DE  0x00,0x00,0x00,0x00,0x00,0x00,0x00,0x00 ;FUNCTION
        DE  0x00,0x00,0x00,0x00,0x00,0x00,0x00,0x00
        DE  0x00,0x00,0x00,0x00,0x00,0x00,0x00,0x00
        DE  0x00,0x00,0x00,0x00,0x00,0x00,0x00,0x01 ; deze laatse is Device nummer

        DE  0x00,0x00,0x00,0x00,0x00,0x00,0x00,0x00 ;FV1
        DE  0x00,0x00,0x00,0x00,0x00,0x00,0x00,0x00
        DE  0x00,0x00,0x00,0x00,0x00,0x00,0x00,0x00
        DE  0x00,0x00,0x00,0x00,0x00,0x00,0x00,0x00

        DE  0x00,0x00,0x00,0x00,0x00,0x00,0x00,0x00 ;FV2
        DE  0x00,0x00,0x00,0x00,0x00,0x00,0x00,0x00
        DE  0x00,0x00,0x00,0x00,0x00,0x00,0x00,0x00
        DE  0x00,0x00,0x00,0x00,0x00,0x00,0x00,0x00

        DE  0x00,0x00,0x00,0x00,0x00,0x00,0x00,0x00 ;FV3
        DE  0x00,0x00,0x00,0x00,0x00,0x00,0x00,0x00
        DE  0x00,0x00,0x00,0x00,0x00,0x00,0x00,0x00
        DE  0x00,0x00,0x00,0x00,0x00,0x00,0x00,0x00

        DE  0x00,0x00,0x00,0x00,0x00,0x00,0x00,0x00 ;BINAIR    
        DE  0x00,0x00,0x00,0x00,0x00,0x00,0x00,0x00
        DE  0x00,0x00,0x00,0x00,0x00,0x00,0x00,0x00
        DE  0x00,0x00,0x00,0x00,0x00,0x00,0x00,0x00

        DE  0x00,0x00,0x00,0x00,0x00,0x00,0x00,0x00 ;ADR1L
        DE  0x00,0x00,0x00,0x00,0x00,0x00,0x00,0x00
        DE  0x00,0x00,0x00,0x00,0x00,0x00,0x00,0x00
        DE  0x00,0x00,0x00,0x00,0x00,0x00,0x00,0x00

        DE  0x00,0x00,0x00,0x00,0x00,0x00,0x00,0x00 ;ADR1H
        DE  0x00,0x00,0x00,0x00,0x00,0x00,0x00,0x00
        DE  0x00,0x00,0x00,0x00,0x00,0x00,0x00,0x00
        DE  0x00,0x00,0x00,0x00,0x00,0x00,0x00,0x00

        DE  0x00,0x00,0x00,0x00,0x00,0x00,0x00,0x00 ;LOGISCHE POORT1
        DE  0x00,0x00,0x00,0x00,0x00,0x00,0x00,0x00 ;LOGISCHE POORT2
        DE  0x00,0x00,0x00,0x00,0x00,0x00,0x00,0x00 ;LOGISCHE POORT3
        DE  0x00,0x00,0x00,0x00,0x00,0x00,0x00,0x00 ;LOGISCHE POORT4

        ORG 0xf00100
		
        DE  0x00,0x00,0x00,0x00,0x00,0x00,0x00,0x00 ;Niet te gebruiken (wordt overschreven in RAM door ADR1L)   
        DE  0x00,0x00,0x00,0x00,0x00,0x00,0x00,0x00
        DE  0x00,0x00,0x00,0x00,0x00,0x00,0x00,0x00
        DE  0x00,0x00,0x00,0x00,0x00,0x00,0x00,0x00

        DE  0x00,0x00,0x00,0x00,0x00,0x00,0x00,0x00 ;Niet te gebruiken (wordt overschreven in RAM door ADR1H)       
        DE  0x00,0x00,0x00,0x00,0x00,0x00,0x00,0x00
        DE  0x00,0x00,0x00,0x00,0x00,0x00,0x00,0x00
        DE  0x00,0x00,0x00,0x00,0x00,0x00,0x00,0x00

        DE  0x00,0x00,0x00,0x00,0x00,0x00,0x00,0x00 ;ADR2L
        DE  0x00,0x00,0x00,0x00,0x00,0x00,0x00,0x00
        DE  0x00,0x00,0x00,0x00,0x00,0x00,0x00,0x00
        DE  0x00,0x00,0x00,0x00,0x00,0x00,0x00,0x00

        DE  0x00,0x00,0x00,0x00,0x00,0x00,0x00,0x00 ;ADR2H       
        DE  0x00,0x00,0x00,0x00,0x00,0x00,0x00,0x00
        DE  0x00,0x00,0x00,0x00,0x00,0x00,0x00,0x00
        DE  0x00,0x00,0x00,0x00,0x00,0x00,0x00,0x00

        DE  0x00,0x00,0x00,0x00,0x00,0x00,0x00,0x00 ;ADR3L
        DE  0x00,0x00,0x00,0x00,0x00,0x00,0x00,0x00
        DE  0x00,0x00,0x00,0x00,0x00,0x00,0x00,0x00
        DE  0x00,0x00,0x00,0x00,0x00,0x00,0x00,0x00

        DE  0x00,0x00,0x00,0x00,0x00,0x00,0x00,0x00 ;ADR3H       
        DE  0x00,0x00,0x00,0x00,0x00,0x00,0x00,0x00
        DE  0x00,0x00,0x00,0x00,0x00,0x00,0x00,0x00
        DE  0x00,0x00,0x00,0x00,0x00,0x00,0x00,0x00

        DE  0x00,0x00,0x00,0x00,0x00,0x00,0x00,0x00 ;ADR4L
        DE  0x00,0x00,0x00,0x00,0x00,0x00,0x00,0x00
        DE  0x00,0x00,0x00,0x00,0x00,0x00,0x00,0x00
        DE  0x00,0x00,0x00,0x00,0x00,0x00,0x00,0x00

        DE  0x00,0x00,0x00,0x00,0x00,0x00,0x00,0x00 ;ADR4H       
        DE  0x00,0x00,0x00,0x00,0x00,0x00,0x00,0x00
        DE  0x00,0x00,0x00,0x00,0x00,0x00,0x00,0x00
        DE  0x00,0x00,0x00,0x00,0x00,0x00,0x00,0x00

        ORG 0xf00200
        DE  0x00,0x00,0x00,0x00,0x00,0x00,0x00,0x00 ;ADR5L
        DE  0x00,0x00,0x00,0x00,0x00,0x00,0x00,0x00
        DE  0x00,0x00,0x00,0x00,0x00,0x00,0x00,0x00
        DE  0x00,0x00,0x00,0x00,0x00,0x00,0x00,0x00

        DE  0x00,0x00,0x00,0x00,0x00,0x00,0x00,0x00 ;ADR5H       
        DE  0x00,0x00,0x00,0x00,0x00,0x00,0x00,0x00
        DE  0x00,0x00,0x00,0x00,0x00,0x00,0x00,0x00
        DE  0x00,0x00,0x00,0x00,0x00,0x00,0x00,0x00

        DE  0x00,0x00,0x00,0x00,0x00,0x00,0x00,0x00 ;ADR6L
        DE  0x00,0x00,0x00,0x00,0x00,0x00,0x00,0x00
        DE  0x00,0x00,0x00,0x00,0x00,0x00,0x00,0x00
        DE  0x00,0x00,0x00,0x00,0x00,0x00,0x00,0x00

        DE  0x00,0x00,0x00,0x00,0x00,0x00,0x00,0x00 ;ADR6H       
        DE  0x00,0x00,0x00,0x00,0x00,0x00,0x00,0x00
        DE  0x00,0x00,0x00,0x00,0x00,0x00,0x00,0x00
        DE  0x00,0x00,0x00,0x00,0x00,0x00,0x00,0x00

        DE  0x00,0x00,0x00,0x00,0x00,0x00,0x00,0x00 ;ADR7L
        DE  0x00,0x00,0x00,0x00,0x00,0x00,0x00,0x00
        DE  0x00,0x00,0x00,0x00,0x00,0x00,0x00,0x00
        DE  0x00,0x00,0x00,0x00,0x00,0x00,0x00,0x00

        DE  0x00,0x00,0x00,0x00,0x00,0x00,0x00,0x00 ;ADR7H       
        DE  0x00,0x00,0x00,0x00,0x00,0x00,0x00,0x00
        DE  0x00,0x00,0x00,0x00,0x00,0x00,0x00,0x00
        DE  0x00,0x00,0x00,0x00,0x00,0x00,0x00,0x00

        DE  0x00,0x00,0x00,0x00,0x00,0x00,0x00,0x00 ;ADR8L
        DE  0x00,0x00,0x00,0x00,0x00,0x00,0x00,0x00
        DE  0x00,0x00,0x00,0x00,0x00,0x00,0x00,0x00
        DE  0x00,0x00,0x00,0x00,0x00,0x00,0x00,0x00

        DE  0x00,0x00,0x00,0x00,0x00,0x00,0x00,0x00 ;ADR8H       
        DE  0x00,0x00,0x00,0x00,0x00,0x00,0x00,0x00
        DE  0x00,0x00,0x00,0x00,0x00,0x00,0x00,0x00
        DE  0x00,0x00,0x00,0x00,0x00,0x00,0x00,0x00

        ORG 0xf00300
        DE  0x00,0x00,0x00,0x00,0x00,0x00,0x00,0x00 ;ADR9L
        DE  0x00,0x00,0x00,0x00,0x00,0x00,0x00,0x00
        DE  0x00,0x00,0x00,0x00,0x00,0x00,0x00,0x00
        DE  0x00,0x00,0x00,0x00,0x00,0x00,0x00,0x00

        DE  0x00,0x00,0x00,0x00,0x00,0x00,0x00,0x00 ;ADR9H       
        DE  0x00,0x00,0x00,0x00,0x00,0x00,0x00,0x00
        DE  0x00,0x00,0x00,0x00,0x00,0x00,0x00,0x00
        DE  0x00,0x00,0x00,0x00,0x00,0x00,0x00,0x00

        DE  0x00,0x00,0x00,0x00,0x00,0x00,0x00,0x00 ;ADR10L
        DE  0x00,0x00,0x00,0x00,0x00,0x00,0x00,0x00
        DE  0x00,0x00,0x00,0x00,0x00,0x00,0x00,0x00
        DE  0x00,0x00,0x00,0x00,0x00,0x00,0x00,0x00

        DE  0x00,0x00,0x00,0x00,0x00,0x00,0x00,0x00 ;ADR10H       
        DE  0x00,0x00,0x00,0x00,0x00,0x00,0x00,0x00
        DE  0x00,0x00,0x00,0x00,0x00,0x00,0x00,0x00
        DE  0x00,0x00,0x00,0x00,0x00,0x00,0x00,0x00

        DE  0x00,0x00,0x00,0x00,0x00,0x00,0x00,0x00 ;ADR11L
        DE  0x00,0x00,0x00,0x00,0x00,0x00,0x00,0x00
        DE  0x00,0x00,0x00,0x00,0x00,0x00,0x00,0x00
        DE  0x00,0x00,0x00,0x00,0x00,0x00,0x00,0x00

        DE  0x00,0x00,0x00,0x00,0x00,0x00,0x00,0x00 ;ADR11H       
        DE  0x00,0x00,0x00,0x00,0x00,0x00,0x00,0x00
        DE  0x00,0x00,0x00,0x00,0x00,0x00,0x00,0x00
        DE  0x00,0x00,0x00,0x00,0x00,0x00,0x00,0x00

        DE  0x00,0x00,0x00,0x00,0x00,0x00,0x00,0x00 ;ADR12L
        DE  0x00,0x00,0x00,0x00,0x00,0x00,0x00,0x00
        DE  0x00,0x00,0x00,0x00,0x00,0x00,0x00,0x00
        DE  0x00,0x00,0x00,0x00,0x00,0x00,0x00,0x00

        DE  0x00,0x00,0x00,0x00,0x00,0x00,0x00,0x00 ;ADR12H       
        DE  0x00,0x00,0x00,0x00,0x00,0x00,0x00,0x00
        DE  0x00,0x00,0x00,0x00,0x00,0x00,0x00,0x00
        DE  0x00,0x00,0x00,0x00,0x00,0x00,0x00,0x00
		